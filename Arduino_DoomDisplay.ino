/******************************************
 *  Hey Reddit! Some Remarks here:
 *  a) doing this for fun, and there are a lot of points to improve/extend. Feel free to use and share!
 *  b) I used it with a 480*320 display on an Arduino Uno Clone
 *  c) Doom Guy wounded state just scales with the GPU Temp which is just a quick "hack" i will likely extend it and play around with it
 *  d) Most Important Have FUN! :) - buttermilk
 */



#include "Arduino.h"
#include <SPI.h>            // f.k. for Arduino-1.5.2
//#define USE_SDFAT

#include <Adafruit_GFX.h>   // Hardware-specific library
#include <MCUFRIEND_kbv.h>
MCUFRIEND_kbv tft;

#define MIN(X, Y) (((X) < (Y)) ? (X) : (Y))
#define MAX(X, Y) (((X) > (Y)) ? (X) : (Y))

//BMP Load Stuff

//Message Identifiers
#define CPU_TEMP 'A'
#define GPU_TEMP 'B'
#define CPU_LOAD 'C'
#define GPU_LOAD 'D'
#define MB_TEMP 'E'
#define MB_FAN 'F'
#define RAM_LOAD 'G'

//Colors
#define	BLACK   0x0000
#define	BLUE    0x001F
#define	RED     0xD861
#define	GREEN   0x04C7
#define CYAN    0x07FF
#define MAGENTA 0xF81F
#define YELLOW  0xFFE0
#define ORANGE  0xDB60
#define GRAY 	0xC638
#define WHITE   0xFFFF
#define BG_COL 0x931D
#define TEXT_COL 0x18C3
#define ALPHA_COL  0x07FF

//define GLUE_Demo_480x320
#define MAX_X  480
#define MAY_Y  320


#define STATE_WAIT 0
#define STATE_RUN 1
char State;

//History for Graph Data
#define HIST_LEN 30
short GPU_TEMP_HIST[HIST_LEN];
short GPU_HIST_CNT;

short CPU_TEMP_HIST[HIST_LEN];
short CPU_HIST_CNT;

const unsigned short DoomGuy1_side[696] PROGMEM={
	0x07FF, 0x07FF, 0x07FF, 0x07FF, 0x07FF, 0x49A3, 0x5A04, 0x5A04, 0x5A04, 0x6A24, 0x7265, 0x7265, 0x7265, 0x7265, 0x7265, 0x6A24,   // 0x0010 (16) pixels
	0x5A04, 0x5A04, 0x49A3, 0x07FF, 0x07FF, 0x07FF, 0x07FF, 0x07FF, 0x07FF, 0x07FF, 0x07FF, 0x3142, 0x5A04, 0x51E3, 0x7A85, 0x8AE6,   // 0x0020 (32) pixels
	0xAB68, 0xBBC9, 0xCC0A, 0xCC0A, 0xCC0A, 0xBBC9, 0xAB68, 0x9B07, 0x7265, 0x5A04, 0x51E3, 0x5A04, 0x3142, 0x07FF, 0x07FF, 0x07FF,   // 0x0030 (48) pixels
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	0x07FF, 0x07FF, 0x07FF, 0x07FF, 0x07FF, 0x07FF, 0x07FF, 0x07FF, 0x6A24, 0x8AE6, 0xA347, 0xA347, 0xA347, 0xA347, 0x8AE6, 0x6A24,   // 0x02B0 (688) pixels
	};


const unsigned short DoomGuy1_neutral[696] PROGMEM={
0x07FF, 0x07FF, 0x07FF, 0x07FF, 0x07FF, 0x49A3, 0x5A04, 0x5A04, 0x5A04, 0x6A24, 0x7265, 0x7265, 0x7265, 0x7265, 0x7265, 0x6A24,   // 0x0010 (16) pixels
0x5A04, 0x5A04, 0x49A3, 0x07FF, 0x07FF, 0x07FF, 0x07FF, 0x07FF, 0x07FF, 0x07FF, 0x07FF, 0x3142, 0x5A04, 0x51E3, 0x7A85, 0x8AE6,   // 0x0020 (32) pixels
0xAB68, 0xBBC9, 0xCC0A, 0xCC0A, 0xCC0A, 0xBBC9, 0xAB68, 0x9B07, 0x7265, 0x5A04, 0x51E3, 0x5A04, 0x3142, 0x07FF, 0x07FF, 0x07FF,   // 0x0030 (48) pixels
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0x07FF, 0x07FF, 0x07FF, 0x07FF, 0x07FF, 0x07FF, 0x07FF, 0x07FF, 0x6A24, 0x8AE6, 0xA347, 0xA347, 0xA347, 0xA347, 0x8AE6, 0x6A24,   // 0x02B0 (688) pixels
};



const unsigned short DoomGuy2_neutral[696] PROGMEM={
0x07FF, 0x07FF, 0x07FF, 0x3142, 0x5A04, 0x51E3, 0x7265, 0x82A6, 0xAB68, 0xAB68, 0xB388, 0xB388, 0xAB68, 0x9B07, 0x8AE6, 0x7265,   // 0x0010 (16) pixels
0x6A24, 0x5A04, 0x51E3, 0x5A04, 0x3142, 0x07FF, 0x07FF, 0x07FF, 0x07FF, 0x07FF, 0x3142, 0x51E3, 0x6A24, 0x82A6, 0x8AE6, 0xA347,   // 0x0020 (32) pixels
0xBBC9, 0xCBE9, 0xCBE9, 0xBBC9, 0xBBC9, 0xAB68, 0x9B07, 0x8AE6, 0x82A6, 0x7265, 0x7265, 0x6A24, 0x49A3, 0x3142, 0x07FF, 0x07FF,   // 0x0030 (48) pixels
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0x07FF, 0x07FF, 0x07FF, 0x07FF, 0x07FF, 0x07FF, 0x07FF, 0x07FF, 0x8AE6, 0xB388, 0xB388, 0xB388, 0xB388, 0xB388, 0xB388, 0x8AE6,   // 0x02B0 (688) pixels
};

const unsigned short DoomGuy_grin[696] PROGMEM={
0x07FF, 0x07FF, 0x07FF, 0x3142, 0x5A04, 0x51E3, 0x5A04, 0x6A24, 0x7265, 0x8AE6, 0x9B07, 0x9B07, 0x9B07, 0x9B07, 0x8AE6, 0x7265,   // 0x0010 (16) pixels
0x6A24, 0x5A04, 0x51E3, 0x5A04, 0x3142, 0x07FF, 0x07FF, 0x07FF, 0x07FF, 0x07FF, 0x3142, 0x51E3, 0x6A24, 0x8AE6, 0x8AE6, 0xA347,   // 0x0020 (32) pixels
0xA347, 0xAB68, 0xAB68, 0xBBC9, 0xB388, 0xAB68, 0x9B07, 0x8AE6, 0x82A6, 0x7265, 0x7265, 0x6A24, 0x49A3, 0x3142, 0x07FF, 0x07FF,   // 0x0030 (48) pixels
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0x07FF, 0x07FF, 0x07FF, 0x07FF, 0x07FF, 0x07FF, 0x07FF, 0x07FF, 0x07FF, 0x5A04, 0x9165, 0xB388, 0xB388, 0x8AE6, 0x5A04, 0x07FF,   // 0x02B0 (688) pixels
};

const unsigned short DoomGuy2_side[696] PROGMEM={
0x07FF, 0x07FF, 0x07FF, 0x07FF, 0x07FF, 0x49A3, 0x5A04, 0x5A04, 0x6A24, 0x7265, 0x7265, 0x7265, 0x7265, 0x7265, 0x7265, 0x6A24,   // 0x0010 (16) pixels
0x5A04, 0x5A04, 0x49A3, 0x07FF, 0x07FF, 0x07FF, 0x07FF, 0x07FF, 0x07FF, 0x07FF, 0x07FF, 0x3142, 0x3142, 0x5A04, 0x51E3, 0x5A04,   // 0x0020 (32) pixels
0x6A24, 0x7265, 0x8AE6, 0x9B07, 0x9B07, 0x9B07, 0x9B07, 0x8AE6, 0x7265, 0x6A24, 0x5A04, 0x51E3, 0x3142, 0x07FF, 0x07FF, 0x07FF,   // 0x0030 (48) pixels
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0x07FF, 0x07FF, 0x07FF, 0x07FF, 0x07FF, 0x07FF, 0x07FF, 0x51E3, 0xA347, 0xB388, 0xD44B, 0xE4CD, 0xFDF3, 0xFDF3, 0xE4CD, 0xD44B,   // 0x02B0 (688) pixels
};


const unsigned short DoomGuy_godmode[696] PROGMEM={
0x07FF, 0x07FF, 0x07FF, 0x07FF, 0x07FF, 0x49A3, 0x5A04, 0x5A04, 0x5A04, 0x6A24, 0x7265, 0x7265, 0x7265, 0x7265, 0x7265, 0x6A24,   // 0x0010 (16) pixels
0x5A04, 0x5A04, 0x49A3, 0x07FF, 0x07FF, 0x07FF, 0x07FF, 0x07FF, 0x07FF, 0x07FF, 0x07FF, 0x3142, 0x5A04, 0x51E3, 0x5A04, 0x6A24,   // 0x0020 (32) pixels
0x8AE6, 0xBBC9, 0xB388, 0xCC0A, 0xCC0A, 0xB388, 0xAB68, 0x9B07, 0x7265, 0x5A04, 0x51E3, 0x5A04, 0x3142, 0x07FF, 0x07FF, 0x07FF,   // 0x0030 (48) pixels
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0x07FF, 0x07FF, 0x07FF, 0x07FF, 0x07FF, 0x07FF, 0x07FF, 0x2901, 0x6A24, 0x8AE6, 0xA347, 0xA347, 0xA347, 0xA347, 0x8AE6, 0x6A24,   // 0x02B0 (688) pixels
};


const unsigned short DoomGuy_afraid[696] PROGMEM={
0x07FF, 0x07FF, 0x3142, 0x5A04, 0x7265, 0x8AE6, 0x9B07, 0xBBC9, 0xCBE9, 0xCC0A, 0xA347, 0xB388, 0x9B07, 0x9B07, 0x9B07, 0x8AE6,   // 0x0010 (16) pixels
0x8AE6, 0x7265, 0x7265, 0x51E3, 0x49A3, 0x3142, 0x07FF, 0x07FF, 0x07FF, 0x07FF, 0x3142, 0x7265, 0x82A6, 0x7265, 0x8AE6, 0x9B07,   // 0x0020 (32) pixels
0xB388, 0x82A6, 0xAB68, 0x8AE6, 0xA347, 0x7265, 0x7265, 0x7265, 0x7265, 0x5A04, 0x51E3, 0x3142, 0x3142, 0x2901, 0x07FF, 0x07FF,   // 0x0030 (48) pixels
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0x07FF, 0x07FF, 0x07FF, 0x07FF, 0x07FF, 0x07FF, 0x07FF, 0x7265, 0x9B07, 0xCBE9, 0xED0E, 0xFDF3, 0xFDF3, 0xED0E, 0xCBE9, 0x9B07,   // 0x02B0 (688) pixels
};

const unsigned short DoomGuy_grin2[696] PROGMEM={
0x07FF, 0x07FF, 0x07FF, 0x3142, 0x5A04, 0x51E3, 0x5A04, 0x6A24, 0x7265, 0x8AE6, 0x9B07, 0x9B07, 0x9B07, 0x9B07, 0x8AE6, 0x7265,   // 0x0010 (16) pixels
0x6A24, 0x5A04, 0x51E3, 0x5A04, 0x3142, 0x07FF, 0x07FF, 0x07FF, 0x07FF, 0x07FF, 0x3142, 0x51E3, 0x6A24, 0x8AE6, 0x8AE6, 0xA347,   // 0x0020 (32) pixels
0xA347, 0xAB68, 0xAB68, 0xBBC9, 0xB388, 0xAB68, 0x9B07, 0x8AE6, 0x82A6, 0x7265, 0x7265, 0x6A24, 0x49A3, 0x3142, 0x07FF, 0x07FF,   // 0x0030 (48) pixels
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0x07FF, 0x07FF, 0x07FF, 0x07FF, 0x07FF, 0x07FF, 0x07FF, 0x07FF, 0x07FF, 0x5A04, 0x8AE6, 0xB388, 0xB388, 0x8AE6, 0x5A04, 0x07FF,   // 0x02B0 (688) pixels
};

const unsigned short DoomGuy3_neutral[696] PROGMEM={
0x07FF, 0x07FF, 0x07FF, 0x3142, 0x5A04, 0x51E3, 0x5A04, 0x7265, 0x7265, 0xAB68, 0x8AE6, 0x6A24, 0x8AE6, 0xAB68, 0x8AE6, 0x7265,   // 0x0010 (16) pixels
0x82A6, 0x82A6, 0x51E3, 0x5A04, 0x3142, 0x07FF, 0x07FF, 0x07FF, 0x07FF, 0x07FF, 0x3142, 0x51E3, 0x6A24, 0x7265, 0x9B07, 0x8AE6,   // 0x0020 (32) pixels
0xA347, 0x9B07, 0xAB68, 0x8AE6, 0xAB68, 0xCC0A, 0xB388, 0x7265, 0x82A6, 0x7265, 0x8AE6, 0x6A24, 0x49A3, 0x3142, 0x07FF, 0x07FF,   // 0x0030 (48) pixels
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0x07FF, 0x07FF, 0x07FF, 0x07FF, 0x07FF, 0x07FF, 0x07FF, 0x51E3, 0x6A24, 0x8945, 0x9165, 0xA1E7, 0xA1E7, 0x9165, 0xB269, 0xA347,   // 0x02B0 (688) pixels
};


const unsigned short DoomGuy3_side[696] PROGMEM={
0x07FF, 0x07FF, 0x07FF, 0x3142, 0x51E3, 0x5A04, 0x7265, 0x7265, 0xAB68, 0x8AE6, 0x6A24, 0x8AE6, 0xAB68, 0x8AE6, 0x7265, 0x82A6,   // 0x0010 (16) pixels
0x82A6, 0x51E3, 0x5A04, 0x5A04, 0x3142, 0x07FF, 0x07FF, 0x07FF, 0x07FF, 0x07FF, 0x3142, 0x6A24, 0x7265, 0x9B07, 0x8AE6, 0xA347,   // 0x0020 (32) pixels
0x9B07, 0xAB68, 0x8AE6, 0xAB68, 0xCC0A, 0xB388, 0x7265, 0x82A6, 0x7265, 0x8AE6, 0x6A24, 0x6A24, 0x49A3, 0x3142, 0x07FF, 0x07FF,   // 0x0030 (48) pixels
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0x07FF, 0x07FF, 0x07FF, 0x07FF, 0x07FF, 0x07FF, 0x51E3, 0xA347, 0x8945, 0x9165, 0xA1E7, 0xA1E7, 0x9165, 0x8945, 0xA347, 0x51E3,   // 0x02B0 (688) pixels
};


const unsigned short DoomGuy_Eye1[168] PROGMEM={
0x07FF, 0x2901, 0x49A3, 0x7265, 0xB388, 0xE4CD, 0xFDD2, 0xFDD2, 0xE4CD, 0xE4CD, 0xCC0A, 0xD44B, 0xD44B, 0xCC0A, 0xE4CD, 0xE4CD,   // 0x0010 (16) pixels
0xFDD2, 0xFDD2, 0xE4CD, 0xB388, 0x7265, 0x49A3, 0x2901, 0x07FF, 0xB388, 0x6A24, 0x49A3, 0x7265, 0x6A24, 0x6A24, 0x51E3, 0xA347,   // 0x0020 (32) pixels
0xDC8C, 0xB388, 0x7265, 0xB388, 0xB388, 0x7265, 0xB388, 0xDC8C, 0xA347, 0x51E3, 0x6A24, 0x6A24, 0x7265, 0x49A3, 0x6A24, 0xB388,   // 0x0030 (48) pixels
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0x8AE6, 0x5A04, 0x8AE6, 0xCC0A, 0xDC8C, 0xED0E, 0xDC8C, 0xCBE9, 0xFD0B, 0xFDD2, 0xE4CD, 0xFD0B, 0xFD8F, 0xE4CD, 0xFDD2, 0xFD0B,   // 0x00A0 (160) pixels
};

const unsigned short DoomGuy_Eye2[168] PROGMEM={
0x07FF, 0x2901, 0x49A3, 0x7265, 0x3962, 0x0000, 0x51E3, 0x9B07, 0xE4CD, 0xE4CD, 0xCC0A, 0xD44B, 0xD44B, 0xCC0A, 0xE4CD, 0xE4CD,   // 0x0010 (16) pixels
0xFDD2, 0xFDD2, 0xE4CD, 0xB388, 0x7265, 0x49A3, 0x2901, 0x07FF, 0xB388, 0x6A24, 0x49A3, 0x7265, 0x82A6, 0x7265, 0x3962, 0x0000,   // 0x0020 (32) pixels
0x9B07, 0xFDD2, 0xBBC9, 0xF54F, 0xF54F, 0xBBC9, 0xFDD2, 0xDC8C, 0xA347, 0x51E3, 0x3962, 0x3962, 0x7265, 0x49A3, 0x6A24, 0xB388,   // 0x0030 (48) pixels
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0x8AE6, 0x5A04, 0x8AE6, 0xCC0A, 0xDC8C, 0xED0E, 0xDC8C, 0xCBE9, 0xE4CD, 0xFDD2, 0xE4CD, 0xFDD2, 0xFDD2, 0xE4CD, 0xFDD2, 0xE4CD,   // 0x00A0 (160) pixels
};

const unsigned short DoomGuy_Mouth[288] PROGMEM={
0x07FF, 0x5A04, 0x82A6, 0xD44B, 0xD44B, 0xA347, 0xD44B, 0xE4CD, 0xF54F, 0xD44B, 0xAB68, 0xF54F, 0xF54F, 0xAB68, 0xD44B, 0xF54F,   // 0x0010 (16) pixels
0xE4CD, 0xD44B, 0xA347, 0xD44B, 0xD44B, 0x82A6, 0x5A04, 0x07FF, 0x07FF, 0x5A04, 0x7265, 0xA347, 0xAB68, 0xBBC9, 0xFDD2, 0xD44B,   // 0x0020 (32) pixels
0xA347, 0x7265, 0xE4CD, 0xFDD2, 0xFDD2, 0xE4CD, 0x7265, 0xA347, 0xD44B, 0xFDD2, 0xBBC9, 0xAB68, 0xA347, 0x7265, 0x5A04, 0x07FF,   // 0x0030 (48) pixels
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0x8AE6, 0xB388, 0xB388, 0xB388, 0xB388, 0xB388, 0xB388, 0x8AE6, 0x07FF, 0x07FF, 0x07FF, 0x07FF, 0x07FF, 0x07FF, 0x07FF, 0x07FF,   // 0x0120 (288) pixels
};

#define FACE1_NEUTRAL1 		0
#define FACE1_NEUTRAL2 		1
#define FACE1_LEFT 			2
#define FACE1_RIGHT 		3
#define FACE2_NEUTRAL1 		4
#define FACE2_NEUTRAL2 		5
#define FACE2_LEFT 			6
#define FACE2_RIGHT 		7
#define FACE3_NEUTRAL1 		8
#define FACE3_NEUTRAL2 		9
#define FACE3_LEFT			10
#define FACE3_RIGHT 		11
#define FACE_GRIN 			12
#define FACE_SUPRISED		13
#define FACE_GOD			14


#define FACE_MODE_NORMAL		0
#define FACE_MODE_WOUNDED		1
#define FACE_MODE_BADLYWOUNDED	2
#define FACE_MODE_GOD			3
#define FACE_MODE_SUPRISED		4
#define FACE_MODE_GRIN			5
char Face_Mode = 0;

//Configuration of Face Appearence
#define FACE_X			50
#define FACE_Y			204
#define FACE_ATIME		2000


char Face_State = 0;



//Timer
unsigned long time;

void drawImg(int x,int y,int w,int h,const unsigned short *bmp,int alpha,bool dontflip, int bg_col = 0, int size = 4);

void setup()
{

	//Screen Stuff
    uint16_t ID;
    ID = tft.readID();
    if (ID == 0x0D3D3) ID = 0x9481;

    tft.begin(ID);
    tft.setRotation(3);
    tft.setTextColor(TEXT_COL, BG_COL);
    tft.setTextSize(3);
    tft.fillScreen(BLACK);

    drawImg(150,75,24,29,DoomGuy1_neutral, ALPHA_COL, true,BLACK, 6);

    tft.setCursor(0, 0);
    tft.print("GET READY ...");

	// StartUp Serial Connection
	Serial.begin(115200);
    while (!Serial) {
    ; // wait for serial port to connect. Needed for Native USB only
    }

   State = STATE_WAIT;
}




// The loop function is called in an endless loop
void loop()
{


	if(State == STATE_WAIT)
	{
		bool SerialConnected = false;

		while(Serial.available())
		{
			Serial.read(); // Clear Serial Buffer
			SerialConnected = true;
		}


		if(SerialConnected)
		{
			tft.fillRect(0,0, MAX_X, 102, BG_COL);
			tft.fillRect(0,102, MAX_X, 102,BG_COL);
			tft.fillRect(0, 194, MAX_X, 126, BLACK);

			tft.fillRect(190,216,280,110,BG_COL);
			State = STATE_RUN;
			SetFaceMode(FACE_MODE_NORMAL);
		}

		time = millis();
	}
	else if(State == STATE_RUN)
	{
		int WAITING = true;
		int CHAR_CNT = 0;
		char REC_MSG[16];
		strcpy(REC_MSG, "            ");

		  while(Serial.available())
		  {
			  char input = Serial.read();
			  REC_MSG[CHAR_CNT] = input;
			  CHAR_CNT++;
			  WAITING = false;
		  }

		  if(WAITING == false)
		  {
			  tft.setCursor(0, 0);
			  tft.setTextSize(1);
			  tft.print(REC_MSG[0]);
			  tft.setTextSize(3);

			  if(CPU_TEMP == REC_MSG[0])
			  {
				  REC_MSG[0] = ' ';
				  int temp = atoi(REC_MSG);

				  tft.setCursor(30, 73);
				  tft.print("CPU TEMP ");
				  tft.print(temp);
				  tft.print("C");

				  temp = temp-20; //Offset

				  if(CPU_HIST_CNT > 0){

					  	  temp = MAX(CPU_TEMP_HIST[CPU_HIST_CNT-1]-3, temp);
					  	  temp = MIN(CPU_TEMP_HIST[CPU_HIST_CNT-1]+3, temp);
				  }

				  if(CPU_HIST_CNT<HIST_LEN-1)
				  {
					CPU_TEMP_HIST[CPU_HIST_CNT] = (short) temp;
					CPU_HIST_CNT++;
				  }
				  else
				  {
					  for(int i=0; i < CPU_HIST_CNT-1; i++)
					  {
						  CPU_TEMP_HIST[i] = CPU_TEMP_HIST[i+1];
					  }
					  CPU_TEMP_HIST[CPU_HIST_CNT-1] = (short) temp;
				  }
				  RenderGraph(30,0,70,60,CPU_TEMP_HIST,CPU_HIST_CNT);
			  }
			  else if(GPU_TEMP == REC_MSG[0])
			  {
				  REC_MSG[0] = ' ';
				  int temp = atoi(REC_MSG);

				  short temp_norm = (short) (temp - 20);

				  if(GPU_HIST_CNT > 0){

					  temp_norm = MAX(GPU_TEMP_HIST[GPU_HIST_CNT-1]-3, temp_norm);
					  temp_norm = MIN(GPU_TEMP_HIST[GPU_HIST_CNT-1]+3, temp_norm);
				  }

				  if(GPU_HIST_CNT<HIST_LEN-1)
				  {
					GPU_TEMP_HIST[GPU_HIST_CNT] = temp_norm;
					GPU_HIST_CNT++;
				  }
				  else
				  {
					  for(int i=0; i < GPU_HIST_CNT-1; i++)
					  {
						  GPU_TEMP_HIST[i] = GPU_TEMP_HIST[i+1];
					  }
					  GPU_TEMP_HIST[GPU_HIST_CNT-1] = temp_norm;
				  }
				  RenderGraph(30,96,70,60,GPU_TEMP_HIST,GPU_HIST_CNT);

				  tft.setCursor(30, 170);
				  //tft.setTextColor(TEXT_COL, WHITE);
				  tft.print("GPU TEMP ");
				  tft.print(temp);
				  tft.print("C");
				  //tft.setTextColor(TEXT_COL, BG_COL);

				//This must be extended
				if(temp > 60) SetFaceMode(FACE_MODE_BADLYWOUNDED);
				else if (temp > 43) SetFaceMode(FACE_MODE_WOUNDED);
				else SetFaceMode(FACE_MODE_NORMAL);

			  }
			  else if(GPU_LOAD == REC_MSG[0])
			  {
				  REC_MSG[0] = ' ';
				  int gpu_load = atoi(REC_MSG);

				  tft.setCursor(295, 170);
				  RenderLoadBar_SIDE(300,106, 100, 50,100,gpu_load);



				  tft.print("LOAD ");
				  if(gpu_load < 10) tft.print(" ");
				  if(gpu_load < 100) tft.print(" ");
				  tft.print(gpu_load);
				  tft.print("%");
			  }
			  else if(CPU_LOAD == REC_MSG[0])
			  {
				  REC_MSG[0] = ' ';
				  int cpu_load = atoi(REC_MSG);

				  tft.setCursor(295, 73);
				  RenderLoadBar_SIDE(300,10, 100, 50,100,cpu_load);

				  tft.print("LOAD " );
				  if(cpu_load < 10) tft.print(" ");
				  if(cpu_load < 100) tft.print(" ");
				  tft.print(cpu_load);
				  tft.print("%");
			  }
			  else if(MB_TEMP == REC_MSG[0])
			  {
				  REC_MSG[0] = ' ';
				  int data = atoi(REC_MSG);

				  tft.setCursor(200, 226);

				  tft.print("MB  TEMP ");
				  if(data < 10) tft.print(" ");
				  if(data < 100) tft.print(" ");
				  if(data < 1000) tft.print(" ");
				  tft.print(data);
				  tft.print("C");
			  }
			  else if(MB_FAN == REC_MSG[0])
			  {
				  REC_MSG[0] = ' ';
				  int data = atoi(REC_MSG);

				  tft.setCursor(200, 255);

				  tft.print("FAN SPEED");
				  if(data < 10) tft.print(" ");
				  if(data < 100) tft.print(" ");
				  if(data < 1000) tft.print(" ");
				  tft.print(data);
				  tft.print("RM");
			  }
			  else if(RAM_LOAD == REC_MSG[0])
			  {
				  REC_MSG[0] = ' ';
				  int data = atoi(REC_MSG);

				  tft.setCursor(200, 285);

				  tft.print("RAM LOAD ");
				  if(data < 10) tft.print(" ");
				  if(data < 100) tft.print(" ");
				  if(data < 1000) tft.print(" ");
				  tft.print(data);
				  tft.print("%");
			  }
		  }
		  else
		  {
			RenderFace();
		  }
	}
	else
	{
		State = STATE_WAIT;
	}

}


void RenderFace()
{
	if(time > millis()) time = millis();

	  if(time + FACE_ATIME < millis())
	  {
		 time = millis();

		 if(Face_State == FACE1_NEUTRAL1)
		 {
			 drawImg(FACE_X,FACE_Y,24,29,DoomGuy1_neutral, ALPHA_COL, true);


			 int NextState = rand()%6;
			 if(NextState == 1) Face_State = FACE1_LEFT;
			 else if (NextState == 2) Face_State = FACE1_RIGHT;
			 else Face_State = FACE1_NEUTRAL1;

		 }
		 else if(Face_State == FACE1_LEFT)
		 {
			 drawImg(FACE_X,FACE_Y,24,29,DoomGuy1_side, ALPHA_COL, false);
			 Face_State = FACE1_NEUTRAL1;
		 }
		 else if(Face_State== FACE1_RIGHT)
		 {
			 drawImg(FACE_X,FACE_Y,24,29,DoomGuy1_side, ALPHA_COL, true);
			 Face_State = FACE1_NEUTRAL1;
		 }
		 else if(Face_State == FACE2_NEUTRAL1)
		 {
			 drawImg(FACE_X,FACE_Y,24,29,DoomGuy2_neutral, ALPHA_COL, true);
			 Face_State = FACE2_LEFT;

			 int NextState = rand()%6;
			 if(NextState == 1) Face_State = FACE2_LEFT;
			 else if (NextState == 2) Face_State = FACE2_RIGHT;
			 else Face_State = FACE2_NEUTRAL1;
		 }
		 else if(Face_State == FACE2_LEFT)
		 {
			 drawImg(FACE_X,FACE_Y,24,29,DoomGuy2_side, ALPHA_COL, false);
			 Face_State = FACE2_NEUTRAL1;
		 }
		 else if(Face_State== FACE2_RIGHT)
		 {
			 drawImg(FACE_X,FACE_Y,24,29,DoomGuy2_side, ALPHA_COL, true);
			 Face_State = FACE2_NEUTRAL1;
		 }
		 else if(Face_State == FACE3_NEUTRAL1)
		 {
			 drawImg(FACE_X,FACE_Y,24,29,DoomGuy3_neutral, ALPHA_COL, true);
			 int NextState = rand()%6;
			 if(NextState == 1) Face_State = FACE3_LEFT;
			 else if (NextState == 2) Face_State = FACE3_RIGHT;
			 else Face_State = FACE3_NEUTRAL1;
		 }
		 else if(Face_State == FACE3_LEFT)
		 {
			 drawImg(FACE_X,FACE_Y,24,29,DoomGuy3_neutral, ALPHA_COL, false);
			 Face_State = FACE3_NEUTRAL1;
		 }
		 else if(Face_State == FACE3_RIGHT)
		 {
			 drawImg(FACE_X,FACE_Y,24,29,DoomGuy3_neutral, ALPHA_COL, false);
			 Face_State = FACE3_NEUTRAL1;
		 }
		 else if(Face_State == FACE_GRIN)
		 {
			 drawImg(FACE_X,FACE_Y,24,29,DoomGuy_grin, ALPHA_COL, true);
			 Face_State = FACE2_NEUTRAL1;
		 }
		 else if(Face_State == FACE_SUPRISED)
		 {
			 drawImg(FACE_X,FACE_Y,24,29,DoomGuy_grin, ALPHA_COL, true);
			 Face_State = FACE3_NEUTRAL1;
		 }
		 else if(Face_State == FACE_GOD)
		 {
			 drawImg(FACE_X,FACE_Y,24,29,DoomGuy_grin, ALPHA_COL, true);
			 Face_State = FACE1_NEUTRAL1;
		 }
	  }
}

void SetFaceMode(char mode)
{
	if(mode==Face_Mode) return;

	Face_Mode = mode;

	switch(mode)
	{
		case FACE_MODE_NORMAL:
		Face_State = FACE_GOD;
		break;

		case FACE_MODE_WOUNDED:
		Face_State = FACE_GRIN;
		break;

		case FACE_MODE_BADLYWOUNDED:
		Face_State = FACE_SUPRISED;
		break;
	}
}



void RenderLoadBar(int x, int y, int width, int height,int max,int value)
{
	int seg = 6;
	int space = 2;
	int seg_h = ((height+space) / (seg)) - 2*space;

	int num_seg = (value*seg/max);
	int color;

	if (num_seg < 0.4*seg) color = GREEN;
	else if (num_seg < 0.75*seg) color = ORANGE;
	else color = RED;

	//tft.fillRect(x,y,width,height, BG_COL); // Clear Area


	for(int i = 0; i<=seg; i++)
	{
		if(i>num_seg) color = BLUE;
		tft.fillRect(x, (y + height) - ((i+1)*(seg_h+space)) + space, width, seg_h, color);
		//tft.fillRect((y + height) - ((i+1)*(seg_h+space)) + space,x, seg_h,  width, color);

	}
}

void RenderLoadBar_SIDE(int x, int y, int width, int height,int max,int value)
{
	int seg = 6;
	int space = 2;
	int seg_w = ((width+space) / (seg)) - 2*space;

	int num_seg = (value*seg / (max*0.9) );
	int color;

	if (num_seg < 0.4*seg) color = GREEN;
	else if (num_seg < 0.75*seg) color = ORANGE;
	else color = RED;

	for(int i = 0; i<=seg; i++)
	{
		if(i>num_seg) color = BLUE;
		tft.fillRect(x + ((i+1)*(seg_w+space)) + space, y, seg_w, height, color);
	}
}


void RenderGraph(int x, int y, int height, int max, short val[],char points)
{
	int scale = 5;
	int scalex = 9;

	tft.fillRect(x,y,(points*(scalex-2)+(scalex/2)),height, GRAY); // Clear Area

	for(int i=0; i<points; i++)
	{
		//int col = BLUE;
		//if((val[i]*10 / max) > 7) col = RED;
		//else if((val[i]*10 / max) > 4) col = ORANGE;

		unsigned long col;

		if(val[i] < 20) col = 31<<5;
		else if(val[i] > (max - 5)) col = 31 << 11;
		else
			{
				int col_val = val[i] - 20;
				int col_max = max - 30;
				col = (MIN(((col_val *32) / col_max),31) << 11) + (MAX(((col_max-col_val)*32 / col_max),0)<<5);
			}

		int val_norm = MIN(val[i], max);
		tft.fillRect(x+i*(scalex-2), (y+height) - val_norm,scalex,val_norm, col);
	}
}

void drawImg(int x,int y,int w,int h,const unsigned short *bmp,int alpha,bool dontflip, int bg_col = 0, int size = 4)
{
	int pos = 0;

	for(int i=0; i<w;i++)
	{
		for(int j=0; j<h;j++)
		{
			if(dontflip) pos = i+(j*w);
			else pos = (w-i)+(j*w);
			int col = pgm_read_word_near(bmp + pos);
			if(col == alpha) col = bg_col;

			tft.fillRect(x + (i*size), y + (j*size), size, size, col);

		}
	}
}

